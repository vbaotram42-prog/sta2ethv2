## sdkconfig.defaults
```kconfig
# Ethernet Configuration
CONFIG_EXAMPLE_ETH_MDC_GPIO=31
CONFIG_EXAMPLE_ETH_MDIO_GPIO=52
CONFIG_EXAMPLE_ETH_PHY_RST_GPIO=51

# WiFi STA Configuration - Hardcoded values
CONFIG_EXAMPLE_WIFI_SSID="xinxin"
CONFIG_EXAMPLE_WIFI_PASSWORD="19840226"

# Additional WiFi and Network settings
CONFIG_ESP_WIFI_STATIC_RX_BUFFER_NUM=10
CONFIG_ESP_WIFI_DYNAMIC_RX_BUFFER_NUM=32
CONFIG_ESP_WIFI_DYNAMIC_TX_BUFFER_NUM=32

# LWIP Configuration for packet forwarding
CONFIG_LWIP_L2_TO_L3_COPY=y
```
